## main/Kconfig.projbuild
```kconfig
menu "Iothub Configuration"

    config WEB_DEFAULT_USERNAME
        string "Factory default web admin username"
        default "admin"
        help
            Factory default username for the web config page.
            Only takes effect when NVS has no credentials yet or after a
            factory reset; it can be changed anytime from the config page.

    config WEB_DEFAULT_PASSWORD
        string "Factory default web admin password"
        default "123456"
        help
            Factory default password for the web config page (paired with the
            default username above). Only takes effect when NVS has no
            credentials yet or after a factory reset; the password can be
            changed anytime from the config page and is stored as a salted
            SHA-256 hash (never in plaintext).
            Recommend a different value per deployment batch.

    menu "GPIO pin assignment"
        config RELAY_GPIO
            int "Relay output GPIO"
            range 0 39
            default 16
            help
                Relay output pin. Must be output-capable (GPIO34-39 are
                input-only). GPIO6-11 and GPIO16-17 are often used by SPI
                flash/PSRAM; verify the module schematic before changing.

        config LED_GPIO
            int "Status LED GPIO"
            range 0 39
            default 4
            help
                Status LED output pin. Must be output-capable.

        config INPUT_GPIO
            int "Digital input GPIO"
            range 0 39
            default 27
            help
                Physical input pin. Used directly for digital switches, or as
                the display/validation pin when INPUT_IS_TOUCH is enabled.
                GPIO34-39 are input-only and have no internal pull-up/pull-down.

        config INPUT_IS_TOUCH
            bool "Input is a capacitive touch pad"
            depends on SOC_TOUCH_SENSOR_SUPPORTED
            default y
            help
                Use the ESP-IDF touch sensor driver instead of digital GPIO.
                The touch channel below must map to INPUT_GPIO.

        config INPUT_TOUCH_CHANNEL
            int "Touch channel (ESP32: 0-9)"
            depends on INPUT_IS_TOUCH
            range 0 9
            default 7
            help
                ESP32 GPIO27 is touch channel 7 (T7). Verify the channel's
                GPIO with the board schematic.

        config INPUT_TOUCH_ACTIVE_PERCENT
            int "Touch active threshold (% of baseline)"
            depends on INPUT_IS_TOUCH
            range 1 20
            default 2
            help
                ESP32 touch V1 uses an absolute threshold:
                active when smooth_data <= baseline * (1 - percent/100).
                Increase the percentage if touch is not detected.

        config INPUT_TOUCH_TOGGLES_LED
            bool "Touch press toggles status LED"
            depends on INPUT_IS_TOUCH
            default y
            help
                On each stable inactive->active touch edge, execute the same
                led.toggle command used by MQTT/BLE/HTTP. Long press does not
                repeat because only the edge triggers one toggle.
    endmenu

    menu "BLE provisioning probe (temporary)"
        config IOTHUB_BLE_PROV_PROBE
            bool "Enable BLE provisioning probe boot mode"
            default n
            help
                Temporary probe: when no provisioning-done marker exists,
                boot into official network_provisioning (Security 1 + PoP)
                instead of the normal Wi-Fi/BLE/MQTT/HTTP stack. After a
                successful Wi-Fi connection and config save, reboot into the
                normal firmware. Do not enable in production builds.

        config IOTHUB_BLE_PROV_POP
            string "Probe PoP"
            depends on IOTHUB_BLE_PROV_PROBE
            default "probe-pop-1234"
            help
                Proof-of-possession used by the probe. Test value only; do
                not use a production secret here.
    endmenu

endmenu
```
